## main/Kconfig.projbuild
```kconfig
menu "Telegram Configuration"

    config TELEGRAM_TOKEN
        string "Telegram API token"
        default "123456789:XXXXXXXXXXXXXXXXXXXXXXXXXXXXXXXXXX"
        help
            Telegram API token.

    config TELEGRAM_CHAT_ID_ACCESS_LIST
        string "Telegram allowed chat_id values"
        default "111111111,2222222222"
        help
            List allowed chat_id values. Character "," is used as the delimiter.

    config TELEGRAM_HTTP_API_URL
        string "Telegram HTTP API URL"
        default "https://api.telegram.org"
        help
            Telegram API token.

endmenu
```

## sdkconfig.defaults
```kconfig
CONFIG_ESPTOOLPY_FLASHSIZE_4MB=y
CONFIG_PARTITION_TABLE_CUSTOM=y
CONFIG_BT_ENABLED=y
CONFIG_BTDM_CTRL_PINNED_TO_CORE_1=y
```
